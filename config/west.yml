## config/west.yml
```yaml
manifest:
  remotes:
    - name: zmkfirmware
      url-base: https://github.com/zmkfirmware
    - name: caksoylar
      url-base: https://github.com/caksoylar
    - name: ftc
      url-base: https://github.com/ftc
  projects:
    - name: zmk
      remote: caksoylar 
      revision: feat/mouse-keys-3.2
      import: app/west.yml
  self:
    path: config
```
